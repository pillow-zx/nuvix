## drivers/Kconfig
```kconfig
menu "Device Drivers"

config RTC_DEVICE
	bool "rtc-drivers"
	default y
	help
	  Read wall-clock time from the Goldfish RTC on QEMU virt.

config VIRTIO
	bool "virtio-drivers"
	default y

config VIRTIO_BLK
	depends on VIRTIO
	bool "virtio-blk"
	default y

config VIRTIO_RNG
	depends on VIRTIO
	bool "virtio-rng"
	default y

config VIRTIO_SND
	depends on VIRTIO
	bool "virtio-snd"
	default y
	help
	  Play signed 16-bit little-endian PCM through /dev/audio.
	
config VIRTIO_GPU
	depends on VIRTIO
	bool "virtio-gpu"
	default y

config VIRTIO_KEYBOARD
	depends on VIRTIO
	bool "virtio-keyboard"
	default y

endmenu
```

## fs/Kconfig
```kconfig
menu "File Systems"

config EXT2_FS
	bool "The Extended 2 (ext2) filesystem"
	default y

config PROC_FS
	bool "The /proc filesystem"
	default y

endmenu
```
