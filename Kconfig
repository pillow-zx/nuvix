## Kconfig
```kconfig
mainmenu "Nuvix Configuration"

menu "General setup"

comment "Nuvix uses a single .config in the repository root."

endmenu

source "arch/$(ARCH)/Kconfig"
source "kernel/Kconfig"
source "fs/Kconfig"
source "mm/Kconfig"
```

## arch/riscv/Kconfig
```kconfig
menu "Soc Selection"

config SOC_QEMU_VIRT
	bool "QEMU Virt Machine"
	default y

endmenu
```

## configs/cuteos_smp_defconfig
```kconfig
CONFIG_ARCH_RISCV=y
CONFIG_PLATFORM_QEMU_VIRT=y
CONFIG_DRAM_SIZE_MB=256
CONFIG_QEMU_CPUS=2
CONFIG_EXT2_FS=y
CONFIG_ROOTFS_IMAGE_SIZE_MB=16
CONFIG_CC_OPTIMIZE_O2=y
CONFIG_GC_SECTIONS=y
CONFIG_LTO=y
# CONFIG_FRAME_POINTER is not set
# CONFIG_DEBUG_CONTEXT is not set
# CONFIG_DEBUG_INFO is not set
# CONFIG_UBSAN is not set
# CONFIG_KSYMS is not set
```

## configs/nuvix_defconfig
```kconfig
CONFIG_CC_OPTIMIZE_O2=y
CONFIG_DEBUG_INFO=y
CONFIG_DEBUG_LOCK=y
CONFIG_DEBUG_REFCOUNT=y
CONFIG_DEBUG_ALLOC=y
CONFIG_DEBUG_CONTEXT=y
CONFIG_DEBUG_TRACE=y
CONFIG_SMP=y
```

## drivers/Kconfig
```kconfig
menu "Device Drivers"

config VIRTIO
	bool "virtio-drivers"
	default y

config VIRTIO_BLK
	depends on VIRTIO
	bool "virtio-blk"
	default y

config VIRTIO_RNG
	depends on VIRTIO
	bool "virtio-rng"
	default y

endmenu
```

## fs/Kconfig
```kconfig
menu "File Systems"

config EXT2_FS
	bool "The Extended 2 (ext2) filesystem"
	default y

endmenu
```

## kernel/Kconfig
```kconfig
config SMP
	bool "SMP subsystem support"
	default n

config NR_CPUS
	int "Maximum supported CPU count" if SMP
	range 1 64
	default 1 if !SMP
	default 8
	help
	  Capacity of static CPU arrays. The DTB supplies the actual topology.
	  Enabled harts beyond this capacity are not started and are reported.
	  UP uses only the boot hart. Hart IDs need not be contiguous.

config SCHED_QUANTUM_MS
	int "Round-robin time slice (ms)"
	range 1 1000
	default 10

config SMP_BOOT_TIMEOUT_MS
	int "All-CPU startup timeout (ms)"
	depends on SMP
	range 1 60000
	default 1000

config FUTEX
	bool "Futex subsystem support"
	default n

config NR_FUTEX_BUCKETS
	int "Number of futex hash buckets"
	depends on FUTEX
	default 32
	help
	  Number of buckets in the futex wait-queue hash table.
	  Must be a positive power of two.
```

## mm/Kconfig
```kconfig
menu "Memory Management"

config MAX_ORDER
	int "Number of buddy orders"
	range 1 11
	default 11
	help
	  Number of free-list levels, not the largest valid order. A value of 11
	  allows orders 0 through 10, with a largest block of 4 MiB on 4 KiB pages.

config USTACK_PAGES
	int "Initial user stack reservation in pages"
	range 1 256
	default 16
	help
	  Main user stack size in 4 KiB pages, with an unmapped guard below it.
	  Only pages containing startup arguments are allocated during creation.

endmenu
```
